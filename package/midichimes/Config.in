## package/midichimes/Config.in
```kconfig
config BR2_PACKAGE_MIDICHIMES
        bool "midichimes"
        select BR2_PACKAGE_ALSA_LIB
        select BR2_INSTALL_LIBSTDCPP
        depends on BR2_PACKAGE_RTMIDI
        default y
        help
          An application for playing pipe chimes via midi keyboard
```

## package/rtmidi/Config.in
```kconfig
config BR2_PACKAGE_RTMIDI
        bool "rtmidi"
        select BR2_PACKAGE_ALSA_LIB
        select BR2_INSTALL_LIBSTDCPP
        default y
        help
          A C++ library for MIDI interfaces
```
